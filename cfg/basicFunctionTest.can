includes
{
  #include "D:\\Isaac\\Library\\KostalSoftwareTestLibrary.cin"
}

variables
{

}

export testcase powerOn (void) {
  stateMachine("powerOn",routeNum,noParaPick);
}

export testcase powerOff (void) {
  stateMachine("powerOff",routeNum,noParaPick);
}

export testcase initProduct (void) {
  stateMachine("initProduct",routeNum,noParaPick);
}

export testcase readSwVer (void) {
  stateMachine("readSwVer",routeNum,noParaPick);
}

export testcase chkDrivingModeReqSigImpWhenIgnOff (char doorSignal[],char msWaitForTurnOn[],char drvModeReqVal[]) {
  char paraPick[3][2][100] = {{"doorSignal",""},{"msWaitForTurnOn",""},{"drvModeReqVal",""}};
  strncpy(paraPick[0][1],doorSignal,elCount(paraPick[0][1]));
  strncpy(paraPick[1][1],msWaitForTurnOn,elCount(paraPick[1][1]));
  strncpy(paraPick[2][1],drvModeReqVal,elCount(paraPick[2][1]));
  stateMachine("chkDrivingModeReqSigImpWhenIgnOff",routeNum,paraPick);
}

export testcase chkALCMLightLvlSetSigImpWhenIgnOff (char doorSignal[],char msWaitForTurnOn[],char alcmLightLvlSetVal[]) {
  char paraPick[3][2][100] = {{"doorSignal",""},{"msWaitForTurnOn",""},{"alcmLightLvlSetVal",""}};
  strncpy(paraPick[0][1],doorSignal,elCount(paraPick[0][1]));
  strncpy(paraPick[1][1],msWaitForTurnOn,elCount(paraPick[1][1]));
  strncpy(paraPick[2][1],alcmLightLvlSetVal,elCount(paraPick[2][1]));
  stateMachine("chkALCMLightLvlSetSigImpWhenIgnOff",routeNum,paraPick);
}

export testcase chkPosLmpStslSigImpWhenIgnOff (char sysPwrModeVal[],char doorSignal[],char posLmpStsVal[]) {
  char paraPick[3][2][100] = {{"sysPwrModeVal",""},{"doorSignal",""},{"posLmpStsVal",""}};
  strncpy(paraPick[0][1],sysPwrModeVal,elCount(paraPick[0][1]));
  strncpy(paraPick[1][1],doorSignal,elCount(paraPick[1][1]));
  strncpy(paraPick[2][1],posLmpStsVal,elCount(paraPick[2][1]));
  stateMachine("chkPosLmpStslSigImpWhenIgnOff",routeNum,paraPick);
}

export testcase chkDoorOpenSignalImpWhenMode0IgnOff (char doorSignal[],char msWaitForTurnOn[]) {
  char paraPick[2][2][100] = {{"doorSignal",""},{"msWaitForTurnOn",""}};
  strncpy(paraPick[0][1],doorSignal,elCount(paraPick[0][1]));
  strncpy(paraPick[1][1],msWaitForTurnOn,elCount(paraPick[1][1]));
  stateMachine("chkDoorOpenSignalImpWhenMode0IgnOff",routeNum,paraPick);
}

export testcase chkRisingTimeAndMemoryFunctionOfDoorOpenSignalImpExceptMode0IgnOff (char doorSignal[],char msWaitForTurnOn[],char posLmpStsVal[],char Mode3_6[],char Mode2_5[]) {
  char paraPick[5][2][100] = {{"doorSignal",""},{"msWaitForTurnOn",""},{"posLmpStsVal",""},{"Mode3_6",""},{"Mode2_5",""}};
  strncpy(paraPick[0][1],doorSignal,elCount(paraPick[0][1]));
  strncpy(paraPick[1][1],msWaitForTurnOn,elCount(paraPick[1][1]));
  strncpy(paraPick[2][1],posLmpStsVal,elCount(paraPick[2][1]));
  strncpy(paraPick[3][1],Mode3_6,elCount(paraPick[3][1]));
  strncpy(paraPick[4][1],Mode2_5,elCount(paraPick[4][1]));
  stateMachine("chkRisingTimeAndMemoryFunctionOfDoorOpenSignalImpExceptMode0IgnOff",routeNum,paraPick);
}

export testcase chkAlcmKeepTime (char doorSignal[],char Mode2[],char accOrOnMode[],char msWaitForTurnOn[]) {
  char paraPick[4][2][100] = {{"doorSignal",""},{"Mode2",""},{"accOrOnMode",""},{"msWaitForTurnOn",""}};
  strncpy(paraPick[0][1],doorSignal,elCount(paraPick[0][1]));
  strncpy(paraPick[1][1],Mode2,elCount(paraPick[1][1]));
  strncpy(paraPick[2][1],accOrOnMode,elCount(paraPick[2][1]));
  strncpy(paraPick[3][1],msWaitForTurnOn,elCount(paraPick[3][1]));
  stateMachine("chkAlcmKeepTime",routeNum,paraPick);
}

export testcase chkDrivingModeReqSigImpWhenAccOn (char doorSignal[],char msWaitForTurnOn[],char drvModeReqVal[]) {
  char paraPick[3][2][100] = {{"doorSignal",""},{"msWaitForTurnOn",""},{"drvModeReqVal",""}};
  strncpy(paraPick[0][1],doorSignal,elCount(paraPick[0][1]));
  strncpy(paraPick[1][1],msWaitForTurnOn,elCount(paraPick[1][1]));
  strncpy(paraPick[2][1],drvModeReqVal,elCount(paraPick[2][1]));
  stateMachine("chkDrivingModeReqSigImpWhenAccOn",routeNum,paraPick);
}

export testcase chkALCMLightLvlSetSigImpWhenAccOn (char doorSignal[],char msWaitForTurnOn[],char alcmLightLvlSetVal[]) {
  char paraPick[3][2][100] = {{"doorSignal",""},{"msWaitForTurnOn",""},{"alcmLightLvlSetVal",""}};
  strncpy(paraPick[0][1],doorSignal,elCount(paraPick[0][1]));
  strncpy(paraPick[1][1],msWaitForTurnOn,elCount(paraPick[1][1]));
  strncpy(paraPick[2][1],alcmLightLvlSetVal,elCount(paraPick[2][1]));
  stateMachine("chkALCMLightLvlSetSigImpWhenAccOn",routeNum,paraPick);
}

export testcase chkALCMLightLvlSetSigImpWhenIgnOn (char doorSignal[],char msWaitForTurnOn[],char alcmLightLvlSetVal[],char freqG[],char dutyG[],char freqB[],char dutyB[]) {
  char paraPick[7][2][100] = {{"doorSignal",""},{"msWaitForTurnOn",""},{"alcmLightLvlSetVal",""},{"freqG",""},{"dutyG",""},{"freqB",""},{"dutyB",""}};
  strncpy(paraPick[0][1],doorSignal,elCount(paraPick[0][1]));
  strncpy(paraPick[1][1],msWaitForTurnOn,elCount(paraPick[1][1]));
  strncpy(paraPick[2][1],alcmLightLvlSetVal,elCount(paraPick[2][1]));
  strncpy(paraPick[3][1],freqG,elCount(paraPick[3][1]));
  strncpy(paraPick[4][1],dutyG,elCount(paraPick[4][1]));
  strncpy(paraPick[5][1],freqB,elCount(paraPick[5][1]));
  strncpy(paraPick[6][1],dutyB,elCount(paraPick[6][1]));
  stateMachine("chkALCMLightLvlSetSigImpWhenIgnOn",routeNum,paraPick);
}

export testcase chkAccImpWhenMode0 (char doorSignal[],char msWaitForTurnOn[]) {
  char paraPick[2][2][100] = {{"doorSignal",""},{"msWaitForTurnOn",""}};
  strncpy(paraPick[0][1],doorSignal,elCount(paraPick[0][1]));
  strncpy(paraPick[1][1],msWaitForTurnOn,elCount(paraPick[1][1]));
  stateMachine("chkAccImpWhenMode0",routeNum,paraPick);
}

export testcase chkRisingTimeAndMemoryFunctionOfAccImpExceptMode0SwitchOff (char doorSignal[],char msWaitForTurnOn[],char posLmpStsVal[],int stepRouteNum14,int stepRouteNum16,int stepRouteNum17,int stepRouteNum18,int stepRouteNum19,char Mode3_6[],int stepRouteNum30,int stepRouteNum31,int stepRouteNum32,int stepRouteNum33,int stepRouteNum34,char Mode2_5[]) {
  char paraPick[5][2][100] = {{"doorSignal",""},{"msWaitForTurnOn",""},{"posLmpStsVal",""},{"Mode3_6",""},{"Mode2_5",""}};
  strncpy(paraPick[0][1],doorSignal,elCount(paraPick[0][1]));
  strncpy(paraPick[1][1],msWaitForTurnOn,elCount(paraPick[1][1]));
  strncpy(paraPick[2][1],posLmpStsVal,elCount(paraPick[2][1]));
  routeNum[14] = stepRouteNum14;
  routeNum[16] = stepRouteNum16;
  routeNum[17] = stepRouteNum17;
  routeNum[18] = stepRouteNum18;
  routeNum[19] = stepRouteNum19;
  strncpy(paraPick[3][1],Mode3_6,elCount(paraPick[3][1]));
  routeNum[30] = stepRouteNum30;
  routeNum[31] = stepRouteNum31;
  routeNum[32] = stepRouteNum32;
  routeNum[33] = stepRouteNum33;
  routeNum[34] = stepRouteNum34;
  strncpy(paraPick[4][1],Mode2_5,elCount(paraPick[4][1]));
  stateMachine("chkRisingTimeAndMemoryFunctionOfAccImpExceptMode0SwitchOff",routeNum,paraPick);
}

export testcase chkIgnOnImpWhenMode0 (char doorSignal[],char msWaitForTurnOn[],char pwmMode[]) {
  char paraPick[3][2][100] = {{"doorSignal",""},{"msWaitForTurnOn",""},{"pwmMode",""}};
  strncpy(paraPick[0][1],doorSignal,elCount(paraPick[0][1]));
  strncpy(paraPick[1][1],msWaitForTurnOn,elCount(paraPick[1][1]));
  strncpy(paraPick[2][1],pwmMode,elCount(paraPick[2][1]));
  stateMachine("chkIgnOnImpWhenMode0",routeNum,paraPick);
}

export testcase chkRisingTimeAndMemoryFunctionOfIgnOnImpExceptMode0SwitchOff (char doorSignal[],char msWaitForTurnOn[],int stepRouteNum7,int stepRouteNum8,int stepRouteNum9,int stepRouteNum10,int stepRouteNum11,char pwmMode[]) {
  char paraPick[3][2][100] = {{"doorSignal",""},{"msWaitForTurnOn",""},{"pwmMode",""}};
  strncpy(paraPick[0][1],doorSignal,elCount(paraPick[0][1]));
  strncpy(paraPick[1][1],msWaitForTurnOn,elCount(paraPick[1][1]));
  routeNum[7] = stepRouteNum7;
  routeNum[8] = stepRouteNum8;
  routeNum[9] = stepRouteNum9;
  routeNum[10] = stepRouteNum10;
  routeNum[11] = stepRouteNum11;
  strncpy(paraPick[2][1],pwmMode,elCount(paraPick[2][1]));
  stateMachine("chkRisingTimeAndMemoryFunctionOfIgnOnImpExceptMode0SwitchOff",routeNum,paraPick);
}

export testcase chkAccImpOnColorWhenIgnOffAlcmOn (char doorSignal[],char msWaitForTurnOn[]) {
  char paraPick[2][2][100] = {{"doorSignal",""},{"msWaitForTurnOn",""}};
  strncpy(paraPick[0][1],doorSignal,elCount(paraPick[0][1]));
  strncpy(paraPick[1][1],msWaitForTurnOn,elCount(paraPick[1][1]));
  stateMachine("chkAccImpOnColorWhenIgnOffAlcmOn",routeNum,paraPick);
}

